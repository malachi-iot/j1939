## examples/esp32/cm1_source/main/Kconfig.projbuild
```kconfig
menu "J1939 Example: Cab Message 1"

    config GPIO_BUTTON1
        int "Pin for Button #1"
        default 9 if IDF_TARGET_ESP32C3
        default 0

    config ACTIVE_STATE_BUTTON1
        int "Set 0 for active low (low = pressed)"
        range 0 1
        default 1

    config GPIO_BUTTON2
        int "Pin for Button #2"
        default -1

    config ACTIVE_STATE_BUTTON2
        int "Set 0 for active low"
        range 0 1
        default 1

endmenu
```

## test/esp32/joystick/main/Kconfig.projbuild
```kconfig
menu "J1939 Joystick"

    config GPIO_BUTTON1
        int "Pin for Button #1"
        default 9 if IDF_TARGET_ESP32C3
        default 0

    config ACTIVE_STATE_BUTTON1
        int "Set 0 for active low"
        range 0 1
        default 0

    config BUTTON2
        bool "Enable Button #2"

    if BUTTON2
        config GPIO_BUTTON2
            int "Pin"
            default 2

        config ACTIVE_STATE_BUTTON2
            int "Set 0 for active low"
            range 0 1
            default 0
    endif

    config BUTTON3
        bool "Enable Button #3"

    if BUTTON3
        config GPIO_BUTTON3
            int "Pin"
        
        config ACTIVE_STATE_BUTTON3
            int "Set 0 for active low"
            range 0 1
            default 0
    endif


    config J1939_VEHICLE_SYSTEM_INSTANCE
        int "NAME vehicle system instance"
        default 2

    config J1939_FUNCTION_INSTANCE
        int "NAME function instance"
        default 1 if IDF_TARGET_ESP32C3
        default 0

    config J1939_ECU_INSTANCE
        int "NAME ecu instance"
        default 0

    config STATUS_LED
        int "pin of status LED. -1 means auto-deduce"
        default -1
        help
            Status LED by default is auto-deduced based on selected board.
            This is overridden to a specific IO based on STATUS_LED


endmenu
```

## test/esp32/listener/main/Kconfig.projbuild
```kconfig
menu "J1939 Listener"

        config GPIO_TWAI_TX
                int "Pin for TWAI/CAN TX"
		default 5
		
        config GPIO_TWAI_RX
                int "Pin for TWAI/CAN TX"
		default 4

endmenu
```
